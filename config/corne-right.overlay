#include "corne.dtsi"

&glidepoint_split {
    device = <&glidepoint0>;
};

// Define and enable physical device node
&pro_micro_i2c {
    status = "okay"; // Ensure I2C bus is enabled

    glidepoint0: glidepoint@2a { // Use 0x2a address
        compatible = "cirque,pinnacle";
        reg = <0x2a>; // Use address 0x2a
        status = "okay"; // Enable the device on this side
        dr-gpios = <&pro_micro 1 GPIO_ACTIVE_HIGH>; // Use dr-gpios, map to P0.08 (D0), assume active high
        y-invert; // Invert Y axis
        rotate-90; // Rotate (swap) X and Y axes
        sensitivity = "1x"; // Set sensitivity to highest
    };
};
